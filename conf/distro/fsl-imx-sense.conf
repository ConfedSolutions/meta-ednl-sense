## conf/distro/fsl-imx-sense.conf
```bitbake
# i.MX DISTRO for the FrameBuffer graphical backend witouth 3g, zeroconf, bluetooth, wifi, etc.

include conf/distro/fsl-imx-fb.conf

DISTRO = "fsl-imx-sense"

# Remove conflicting backends.
DISTRO_FEATURES:remove = "3g zeroconf bluetooth wifi gobject-introspection-data "
```

## conf/layer.conf
```bitbake
# We have a conf and classes directory, add to BBPATH
BBPATH .= ":${LAYERDIR}"

# We have a packages directory, add to BBFILES
BBFILES += "${LAYERDIR}/recipes-*/*/*.bb \
            ${LAYERDIR}/recipes-*/*/*.bbappend"

BBFILE_COLLECTIONS += "ednl-sense"
BBFILE_PATTERN_ednl-sense := "^${LAYERDIR}/"
BBFILE_PRIORITY_ednl-sense = "20"

LAYERSERIES_COMPAT_ednl-sense = "scarthgap"
```
